## drivers/input/fingerprint/Kconfig
```kconfig
#
# Fingerprint driver configuration
#

config FINGERPRINT_KEY_FILTER
	bool "Fingerprint Key Filter interface"
	default n
	help

	  If unsure, say N.

menuconfig INPUT_FINGERPRINT
	bool "Fingerprints"
	help
	  Say Y here, and a list of supported fingerprints will be displayed.
	  This option doesn't affect the kernel.

	  If unsure, say Y.

if INPUT_FINGERPRINT
source "drivers/input/fingerprint/fpc/Kconfig"
source "drivers/input/fingerprint/fpc_clover/Kconfig"
source "drivers/input/fingerprint/goodix/Kconfig"
endif
```

## drivers/input/fingerprint/fpc_clover/Kconfig
```kconfig
#-----------------------------------#
#    Kconfig for FingerprintCard    #
#-----------------------------------#

config FPC_FINGERPRINT_CLOVER
	default n
	tristate "fpc1020 fingerprint driver for clover"
```

## drivers/misc/hqhardwareinfo/Kconfig
```kconfig
config HQ_HARDWARE_INFO
	bool CONFIG_HQ_HARDWARE_INFO
	default y
	help
	  CONFIG_HQ_HARDWARE_INFO
```
