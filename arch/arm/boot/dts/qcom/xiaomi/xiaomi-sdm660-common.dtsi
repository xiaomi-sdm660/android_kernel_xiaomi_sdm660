/* Red led was used for powersupply of White led */
&red_led {
	linux,name = "white";
	qcom,duty-ms = <20>;
	qcom,start-idx = <1>;
	qcom,duty-pcts = [ 00 05 0A 0F 14 1D 28 32 3C 4B 64 ];
	qcom,idx-len = <11>;
	qcom,pause-lo = <2000>;
	qcom,pause-hi = <1000>;
	qcom,ramp-step-ms = <100>;
	qcom,lut-flags = <31>; /* loop, ramp up, reverse, pause hi, pause lo */
	qcom,use-blink;
};
